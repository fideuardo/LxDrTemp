/dts-v1/;
/plugin/;

/ {
    fragment@0 {
        target-path = "/";
        __overlay__ {
            simtemp_node: simtemp {
                compatible = "simtemp,collector";
                status = "okay";

                /* Propiedades para sobreescribir los valores por defecto */
                sample-period-us = <500000>; /* 500 ms */
                operation-mode = "one-shot";
            };
        };
    };
};