/dts-v1/;
/plugin/;

/ {
    fragment@0 {
        target-path = "/";
        __overlay__ {
            nxp_simtemp_node: nxp_simtemp {
                compatible = "nxp,simtemp";
                status = "okay";

                /* Propiedades según MSD v0.3 */
                sampling-ms = <500>; /* 500 ms */
            };
        };
    };
};