// SPDX-License-Identifier: GPL-2.0-only
/dts-v1/;
/plugin/;

/ {
    compatible = "brcm,bcm2835";

    fragment@0 {
        target-path = "/";
        __overlay__ {
            simtemp: simtemp {
                compatible = "nxp,simtemp";
                status = "okay";
                sampling-ms = <500>;      /* Período inicial de 500 ms */
                threshold-mC = <45000>;    /* Umbral por defecto en miligrados Celsius */
                operation-mode = "continuous"; /* Modo legacy opcional */
            };
        };
    };
};
